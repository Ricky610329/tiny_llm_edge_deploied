## firmware/tinyllm_idf/sdkconfig.defaults
```kconfig
# 課程基準設定（競賽規則允許在 menuconfig 內調整的起點）
CONFIG_ESP_DEFAULT_CPU_FREQ_MHZ_240=y
CONFIG_COMPILER_OPTIMIZATION_PERF=y
CONFIG_ESPTOOLPY_FLASHMODE_QIO=y
CONFIG_ESPTOOLPY_FLASHFREQ_80M=y
CONFIG_ESP_MAIN_TASK_STACK_SIZE=8192
```
